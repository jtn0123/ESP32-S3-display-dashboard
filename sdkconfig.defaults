## sdkconfig.defaults
```kconfig
# ESP32-S3 specific
CONFIG_IDF_TARGET="esp32s3"
CONFIG_IDF_TARGET_ESP32S3=y

# Flash size
CONFIG_ESPTOOLPY_FLASHSIZE_16MB=y
CONFIG_ESPTOOLPY_FLASHSIZE="16MB"
CONFIG_BOOTLOADER_SPI_FLASH_SIZE_16MB=y
CONFIG_BOOTLOADER_SPI_FLASH_SIZE_AUTO=n

# Enable both CPUs
CONFIG_FREERTOS_UNICORE=n

# Partition Table - Use default two OTA partition table
CONFIG_PARTITION_TABLE_CUSTOM=n
CONFIG_PARTITION_TABLE_TWO_OTA=y
CONFIG_PARTITION_TABLE_SINGLE_APP=n

# OTA Configuration
CONFIG_BOOTLOADER_APP_ROLLBACK_ENABLE=y
CONFIG_BOOTLOADER_APP_ANTI_ROLLBACK=n

# Increase main task stack size to 12KB for ESP_LCD
CONFIG_ESP_MAIN_TASK_STACK_SIZE=12288

# Increase system event task stack
CONFIG_ESP_SYSTEM_EVENT_TASK_STACK_SIZE=4096

# Enable thread local storage for LVGL (if used)
CONFIG_FREERTOS_THREAD_LOCAL_STORAGE_POINTERS=1

# Enable panic handler
CONFIG_ESP_SYSTEM_PANIC_PRINT_HALT=y
CONFIG_ESP_SYSTEM_PANIC_PRINT_REBOOT=y
CONFIG_ESP_SYSTEM_PANIC_PRINT_FLASH=y
CONFIG_ESP_DEBUG_STUBS_ENABLE=y

# Optimize for performance (may help with single DROM segment)
CONFIG_COMPILER_OPTIMIZATION_PERF=y
# CONFIG_COMPILER_OPTIMIZATION_SIZE is not set
# CONFIG_COMPILER_OPTIMIZATION_LEVEL_RELEASE is not set

# HTTP Server
CONFIG_HTTPD_MAX_REQ_HDR_LEN=1024

# WiFi
CONFIG_ESP32_WIFI_STATIC_RX_BUFFER_NUM=10
CONFIG_ESP32_WIFI_DYNAMIC_RX_BUFFER_NUM=32
CONFIG_ESP32_WIFI_TX_BUFFER_TYPE=1
CONFIG_ESP32_WIFI_AMPDU_TX_ENABLED=y
CONFIG_ESP32_WIFI_TX_BA_WIN=6
CONFIG_ESP32_WIFI_AMPDU_RX_ENABLED=y
CONFIG_ESP32_WIFI_RX_BA_WIN=6

# Flash yield settings for WiFi stability during OTA
CONFIG_SPI_FLASH_YIELD_DURING_ERASE=y
CONFIG_SPI_FLASH_ERASE_YIELD_DURATION_MS=50
CONFIG_SPI_FLASH_ERASE_YIELD_TICKS=10

# Power Management
CONFIG_PM_ENABLE=y
CONFIG_PM_DFS_INIT_AUTO=y

# FreeRTOS tick rate (1000 Hz for smoother animations)
CONFIG_FREERTOS_HZ=1000

# Enable console output over USB Serial/JTAG (disable default UART)
CONFIG_ESP_CONSOLE_UART_DEFAULT=n
CONFIG_ESP_CONSOLE_UART_BAUDRATE=115200

# NVS for configuration storage
CONFIG_NVS_ENCRYPTION=n

# Bootloader log level (increase to INFO for diagnostics)
CONFIG_BOOTLOADER_LOG_LEVEL_WARN=n
CONFIG_BOOTLOADER_LOG_LEVEL_INFO=y
CONFIG_LOG_DEFAULT_LEVEL_INFO=y

# Disable core dump to flash (was causing CRC errors) to reduce boot noise
CONFIG_ESP_COREDUMP_ENABLE_TO_FLASH=n
CONFIG_ESP_COREDUMP_ENABLE_TO_NONE=y
# TEMP: Disable PSRAM to isolate early-boot panic after "cpu_start: Multicore app"
CONFIG_ESP32S3_SPIRAM_SUPPORT=n

# Enable PSRAM (8MB on T-Display-S3)
CONFIG_ESP32S3_SPIRAM_SUPPORT=y
CONFIG_SPIRAM=y
CONFIG_SPIRAM_MODE_OCT=y
CONFIG_SPIRAM_SPEED_80M=y
CONFIG_SPIRAM_USE_MALLOC=y
# Reserve more internal memory for network stack (16KB minimum)
CONFIG_SPIRAM_MALLOC_ALWAYSINTERNAL=16384
# Reserve 32KB internal for critical operations
CONFIG_SPIRAM_MALLOC_RESERVE_INTERNAL=32768
# Keep network in internal RAM (critical for stability)
CONFIG_SPIRAM_TRY_ALLOCATE_WIFI_LWIP=n
# Allow BSS segment in external memory for large static buffers
CONFIG_SPIRAM_ALLOW_BSS_SEG_EXTERNAL_MEMORY=y

# Disable unused features to save space
CONFIG_ESP32S3_TRAX=n
CONFIG_ESP32S3_TRACEMEM_RESERVE_DRAM=0

# Force bootloader rebuild every time
CONFIG_BOOTLOADER_REBUILD=y
# Auto-reset after flashing
CONFIG_ESPTOOLPY_AFTER_RESET=y
CONFIG_ESPTOOLPY_AFTER="hard_reset"

# USB CDC settings for proper boot
CONFIG_ESP_CONSOLE_USB_CDC=n
CONFIG_ESP_CONSOLE_USB_SERIAL_JTAG=y

# Merge rodata segments to avoid multiple DROM segments
CONFIG_APP_BUILD_USE_FLASH_SECTIONS=y
CONFIG_APP_RODATA_SEGMENT_MERGE=y

# --- Network reliability tuning (lwIP) ---
# Increase socket count and buffers to reduce handshakes failing under churn
CONFIG_LWIP_MAX_SOCKETS=16
CONFIG_LWIP_TCP_BACKLOG=y
CONFIG_LWIP_TCPIP_TASK_STACK_SIZE=6144
CONFIG_LWIP_TCP_RECVMBOX_SIZE=32
CONFIG_LWIP_TCPIP_RECVMBOX_SIZE=32
CONFIG_LWIP_TCP_SND_BUF=65535
CONFIG_LWIP_TCP_WND_DEFAULT=65535
CONFIG_LWIP_TCP_MSS=1460
CONFIG_LWIP_TCP_SYNMAXRTX=6
CONFIG_LWIP_TCP_MAXRTX=12
CONFIG_LWIP_NETIF_TX_SINGLE_PBUF=y

# WiFi buffer tuning
CONFIG_ESP32_WIFI_DYNAMIC_RX_BUFFER_NUM=64
CONFIG_ESP32_WIFI_STATIC_RX_BUFFER_NUM=16
CONFIG_ESP32_WIFI_TX_BA_WIN=8
CONFIG_ESP32_WIFI_RX_BA_WIN=8

# Disable PM to avoid DFS/light-sleep induced latency on WiFi driver
CONFIG_PM_ENABLE=n
```
